VERSION ""

NS_ :

BS_:

BU_: SampleEcu J1939_Messenger_Node
VAL_TABLE_ ExampleValueTableRx 3 "Fault4" 2 "Fault3" 1 "Fault2" 0 "Fault1" ;
VAL_TABLE_ ExampleValueTableTx 3 "On" 2 "N/A" 1 "N/A" 0 "Off" ;

BO_ 2381316196 ExampleMessageRx: 2 SampleEcu
 SG_ RxSignal2 : 8|2@1+ (1,0) [0|3] ""  J1939_Messenger_Node
 SG_ RxSignal1 : 0|8@1- (1,0) [-128|127] ""  J1939_Messenger_Node

BO_ 2236638457 ExampleMessageTx: 2 J1939_Messenger_Node
 SG_ TxSignal2 : 8|2@1+ (1,0) [0|3] ""  SampleEcu
 SG_ TxSignal1 : 0|8@1- (1,0) [-128|127] "unit"  SampleEcu

BA_DEF_ SG_  "SigType" ENUM  "Default","Range","RangeSigned","ASCII","Discrete","Control","ReferencePGN","DTC","StringDelimiter","StringLength","StringLengthControl","MessageCounter","MessageChecksum";
BA_DEF_ SG_  "GenSigEVName" STRING ;
BA_DEF_ SG_  "GenSigILSupport" ENUM  "No","Yes";
BA_DEF_ SG_  "GenSigSendType" ENUM  "Cyclic","OnWrite","OnWriteWithRepetition","OnChange","OnChangeWithRepetition","IfActive","IfActiveWithRepetition","NoSigSendType";
BA_DEF_ BO_  "GenMsgILSupport" ENUM  "No","Yes";
BA_DEF_ BU_  "NmStationAddress" INT 0 255;
BA_DEF_ BO_  "GenMsgSendType" ENUM  "cyclic","NotUsed","IfActive","NotUsed","NotUsed","NotUsed","NotUsed","NotUsed","noMsgSendType";
BA_DEF_ BO_  "GenMsgRequestable" INT 0 1;
BA_DEF_  "DBName" STRING ;
BA_DEF_  "BusType" STRING ;
BA_DEF_  "ProtocolType" STRING ;
BA_DEF_ BO_  "VFrameFormat" ENUM  "StandardCAN","ExtendedCAN","reserved","J1939PG";
BA_DEF_DEF_  "SigType" "Default";
BA_DEF_DEF_  "GenSigEVName" "Env@Nodename_@Signame";
BA_DEF_DEF_  "GenSigILSupport" "Yes";
BA_DEF_DEF_  "GenSigSendType" "NoSigSendType";
BA_DEF_DEF_  "GenMsgILSupport" "Yes";
BA_DEF_DEF_  "NmStationAddress" 254;
BA_DEF_DEF_  "GenMsgSendType" "noMsgSendType";
BA_DEF_DEF_  "GenMsgRequestable" 1;
BA_DEF_DEF_  "DBName" "";
BA_DEF_DEF_  "BusType" "CAN";
BA_DEF_DEF_  "ProtocolType" "J1939";
BA_DEF_DEF_  "VFrameFormat" "J1939PG";
BA_ "DBName" "J1939Template";
BA_ "NmStationAddress" BU_ SampleEcu 100;
BA_ "NmStationAddress" BU_ J1939_Messenger_Node 249;
VAL_ 2381316196 RxSignal2 3 "Fault4" 2 "Fault3" 1 "Fault2" 0 "Fault1" ;
VAL_ 2236638457 TxSignal2 3 "On" 2 "N/A" 1 "N/A" 0 "Off" ;
